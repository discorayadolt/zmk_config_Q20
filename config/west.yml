## config/west.yml
```yaml
manifest:
  remotes:
    - name: zmkfirmware
      url-base: https://github.com/zmkfirmware
    - name: ZitaoTech
      url-base: https://github.com/ZitaoTech
    - name: ZMK-locales
      url-base: https://github.com/joelspadin/
  projects:
    - name: zmk
      remote: ZitaoTech
      revision: bbkeyboard_tp
      import: app/west.yml
    - name: ZML-Locales
      remote: joelspadin
      revision: main
      import: west.yml
  self:
    path: config
```
